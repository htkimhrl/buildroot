#include "base.dtsi"

&spi0{
	status = "okay";
	bus-num = <1>;	
	num-cs = <4>; 
	is-decoded-cs = <0>;	
	speed-hz = <200000000>;
	speed_hz = <200000000>;

	adxl3450@0x00{
		compatible = "adi,adxl34x";
		reg = <0>;
		spi-max-frequency = <1000000>;
		spi-cpha;
		spi-cpol; 
		interrupt-parent = <&intc>;
		interrupts = <0 29 1>; 
	};
	//spidev1@0x01{
	//	compatible = "spidev"; 
	//	reg = <1>; 
	//	interrupt-parent = <&intc>; 
	//	interrupts = <0 29 4>;
	//	spi-max-frequency = <1000000>;
	//};
	
};
//&amba{
//	axi_gpio_1: gpio@0x41200000{
//		#gpio-cells = <2>;
//		compatible = "xlnx,xps-gpio-1.00.a";
//		gpio-controller;
//		interrupt-parent = <&intc>; 
//		interrupts = <0 29 4>; 
//		reg = <0x41200000 0x10000>;
//		xlnx,all-inputs = <0x1>;
//		xlnx,all-inputs-2 = <0x0>;
//		xlnx,all-outputs = <0x0>;
//		xlnx,all-outputs-2 = <0x0>;
//		xlnx,dout-default = <0x00000000>;
//		xlnx,dout-default-2 = <0x00000000>;
//		xlnx,gpio-width = <0x1>;
//		xlnx,gpio2-width = <0x20>; 
//		xlnx,interrupt-present = <0x1>; 
//		xlnx,is-dual = <0x0>;
//		xlnx,tri-default = <0xFFFFFFFF>;
//		xlnx,tri-default-2 = <0xFFFFFFFF>;
//	};
//
//	axi_gpio_2: gpio@0x41210000{
//		#gpio-cells = <2>;
//		compatible = "xlnx,xps-gpio-1.00.a";
//		gpio-controller;
//		interrupt-parent = <&intc>; 
//		interrupts = <0 30 4>; 
//		reg = <0x41210000 0x10000>;
//		xlnx,all-inputs = <0x1>;
//		xlnx,all-inputs-2 = <0x0>;
//		xlnx,all-outputs = <0x0>;
//		xlnx,all-outputs-2 = <0x0>;
//		xlnx,dout-default = <0x00000000>;
//		xlnx,dout-default-2 = <0x00000000>;
//		xlnx,gpio-width = <0x1>;
//		xlnx,gpio2-width = <0x20>; 
//		xlnx,interrupt-present = <0x1>; 
//		xlnx,is-dual = <0x0>;
//		xlnx,tri-default = <0xFFFFFFFF>;
//		xlnx,tri-default-2 = <0xFFFFFFFF>;
//	};
//
//};
