## board/mathworks/zynq/boards/microzed7020/system.defconfig
```kconfig
BR2_TOOLCHAIN_EXTERNAL_PATH="/opt/Xilinx/SDK/2016.2/gnu/arm/lin"
BR2_LINUX_KERNEL_CUSTOM_REPO_URL="https://github.com/htkimhrl/xilinx-linux.git"
BR2_LINUX_KERNEL_CUSTOM_REPO_VERSION="HRL_system"
BR2_TARGET_UBOOT_CUSTOM_REPO_URL="https://github.com/htkimhrl/xilinx-uboot.git"
BR2_TARGET_UBOOT_CUSTOM_REPO_VERSION="HRL_system"
```

## package/hrl/Config.in
```kconfig
config BR2_PACKAGE_HELLO_HRL
	bool "Hello_HRL"
	help
	  HRL Hello World Test Module with Buildroot 

	  https://
```
